## blinky/build/Kconfig/arch/Kconfig
```kconfig
# Load Zephyr Arch Kconfig descriptions.
osource "D:/Zephyr/zephyr/arch/rx/Kconfig"
osource "D:/Zephyr/zephyr/arch/x86/Kconfig"
osource "D:/Zephyr/zephyr/arch/xtensa/Kconfig"
osource "D:/Zephyr/zephyr/arch/sparc/Kconfig"
osource "D:/Zephyr/zephyr/arch/riscv/Kconfig"
osource "D:/Zephyr/zephyr/arch/posix/Kconfig"
osource "D:/Zephyr/zephyr/arch/mips/Kconfig"
osource "D:/Zephyr/zephyr/arch/arm64/Kconfig"
osource "D:/Zephyr/zephyr/arch/arm/Kconfig"
osource "D:/Zephyr/zephyr/arch/arc/Kconfig"
```

## blinky/build/Kconfig/boards/Kconfig
```kconfig
# Load Zephyr board Kconfig descriptions.
osource "D:/Zephyr/zephyr/boards/st/nucleo_g431rb/Kconfig"
```

## blinky/build/Kconfig/boards/Kconfig.defconfig
```kconfig
# Load Zephyr board defconfig descriptions.
osource "D:/Zephyr/zephyr/boards/st/nucleo_g431rb/Kconfig.defconfig"
```

## blinky/build/Kconfig/boards/Kconfig.nucleo_g431rb
```kconfig
# Load board Kconfig descriptions.
osource "D:/Zephyr/zephyr/boards/st/nucleo_g431rb/Kconfig.nucleo_g431rb"
```

## blinky/build/Kconfig/boards/Kconfig.sysbuild
```kconfig
# Load Sysbuild board Kconfig descriptions.
osource "D:/Zephyr/zephyr/boards/st/nucleo_g431rb/Kconfig.sysbuild"
```

## blinky/build/Kconfig/soc/Kconfig
```kconfig
# Load Zephyr SoC Kconfig descriptions.
osource "D:/Zephyr/zephyr/soc/xlnx/zynqmp/Kconfig"
osource "D:/Zephyr/zephyr/soc/xlnx/zynq7000/Kconfig"
osource "D:/Zephyr/zephyr/soc/xlnx/versalnet/Kconfig"
osource "D:/Zephyr/zephyr/soc/xlnx/versal2/Kconfig"
osource "D:/Zephyr/zephyr/soc/xen/Kconfig"
osource "D:/Zephyr/zephyr/soc/wch/ch32v/Kconfig"
osource "D:/Zephyr/zephyr/soc/ti/simplelink/Kconfig"
osource "D:/Zephyr/zephyr/soc/ti/mspm0/Kconfig"
osource "D:/Zephyr/zephyr/soc/ti/lm3s6965/Kconfig"
osource "D:/Zephyr/zephyr/soc/ti/k3/Kconfig"
osource "D:/Zephyr/zephyr/soc/telink/tlsr/Kconfig"
osource "D:/Zephyr/zephyr/soc/starfive/jh71xx/Kconfig"
osource "D:/Zephyr/zephyr/soc/st/stm32/Kconfig"
osource "D:/Zephyr/zephyr/soc/snps/qemu_arc/Kconfig"
osource "D:/Zephyr/zephyr/soc/snps/nsim/arc_v/Kconfig"
osource "D:/Zephyr/zephyr/soc/snps/nsim/arc_classic/Kconfig"
osource "D:/Zephyr/zephyr/soc/snps/hsdk4xd/Kconfig"
osource "D:/Zephyr/zephyr/soc/snps/hsdk/Kconfig"
osource "D:/Zephyr/zephyr/soc/snps/emsk/Kconfig"
osource "D:/Zephyr/zephyr/soc/snps/emsdp/Kconfig"
osource "D:/Zephyr/zephyr/soc/snps/arc_iot/Kconfig"
osource "D:/Zephyr/zephyr/soc/silabs/Kconfig"
osource "D:/Zephyr/zephyr/soc/sifive/sifive_freedom/Kconfig"
osource "D:/Zephyr/zephyr/soc/sensry/Kconfig"
osource "D:/Zephyr/zephyr/soc/rockchip/Kconfig"
osource "D:/Zephyr/zephyr/soc/renode/riscv_virtual/Kconfig"
osource "D:/Zephyr/zephyr/soc/renode/cortex_r8_virtual/Kconfig"
osource "D:/Zephyr/zephyr/soc/renesas/smartbond/Kconfig"
osource "D:/Zephyr/zephyr/soc/renesas/rz/Kconfig"
osource "D:/Zephyr/zephyr/soc/renesas/rx/Kconfig"
osource "D:/Zephyr/zephyr/soc/renesas/rcar/Kconfig"
osource "D:/Zephyr/zephyr/soc/renesas/ra/Kconfig"
osource "D:/Zephyr/zephyr/soc/realtek/ec/Kconfig"
osource "D:/Zephyr/zephyr/soc/raspberrypi/rpi_pico/Kconfig"
osource "D:/Zephyr/zephyr/soc/quicklogic/eos_s3/Kconfig"
osource "D:/Zephyr/zephyr/soc/qemu/virt_riscv/Kconfig"
osource "D:/Zephyr/zephyr/soc/qemu/malta/Kconfig"
osource "D:/Zephyr/zephyr/soc/openisa/rv32m1/Kconfig"
osource "D:/Zephyr/zephyr/soc/openhwgroup/cva6/Kconfig"
osource "D:/Zephyr/zephyr/soc/oct/osd32mp15x/Kconfig"
osource "D:/Zephyr/zephyr/soc/nxp/s32/Kconfig"
osource "D:/Zephyr/zephyr/soc/nxp/rw/Kconfig"
osource "D:/Zephyr/zephyr/soc/nxp/mcx/Kconfig"
osource "D:/Zephyr/zephyr/soc/nxp/lpc/Kconfig"
osource "D:/Zephyr/zephyr/soc/nxp/layerscape/Kconfig"
osource "D:/Zephyr/zephyr/soc/nxp/kinetis/Kconfig"
osource "D:/Zephyr/zephyr/soc/nxp/imxrt/Kconfig"
osource "D:/Zephyr/zephyr/soc/nxp/imx/Kconfig"
osource "D:/Zephyr/zephyr/soc/nuvoton/numicro/Kconfig"
osource "D:/Zephyr/zephyr/soc/nuvoton/numaker/Kconfig"
osource "D:/Zephyr/zephyr/soc/nuvoton/npcx/Kconfig"
osource "D:/Zephyr/zephyr/soc/nuvoton/npcm/Kconfig"
osource "D:/Zephyr/zephyr/soc/nordic/Kconfig"
osource "D:/Zephyr/zephyr/soc/neorv32/Kconfig"
osource "D:/Zephyr/zephyr/soc/native/inf_clock/Kconfig"
osource "D:/Zephyr/zephyr/soc/microchip/sam/Kconfig"
osource "D:/Zephyr/zephyr/soc/microchip/miv/Kconfig"
osource "D:/Zephyr/zephyr/soc/microchip/mec/Kconfig"
osource "D:/Zephyr/zephyr/soc/mediatek/mt8xxx/Kconfig"
osource "D:/Zephyr/zephyr/soc/lowrisc/opentitan/Kconfig"
osource "D:/Zephyr/zephyr/soc/litex/litex_vexriscv/Kconfig"
osource "D:/Zephyr/zephyr/soc/ite/ec/Kconfig"
osource "D:/Zephyr/zephyr/soc/intel/raptor_lake/Kconfig"
osource "D:/Zephyr/zephyr/soc/intel/lakemont/Kconfig"
osource "D:/Zephyr/zephyr/soc/intel/intel_socfpga_std/Kconfig"
osource "D:/Zephyr/zephyr/soc/intel/intel_socfpga/Kconfig"
osource "D:/Zephyr/zephyr/soc/intel/intel_niosv/Kconfig"
osource "D:/Zephyr/zephyr/soc/intel/intel_ish/Kconfig"
osource "D:/Zephyr/zephyr/soc/intel/intel_adsp/Kconfig"
osource "D:/Zephyr/zephyr/soc/intel/elkhart_lake/Kconfig"
osource "D:/Zephyr/zephyr/soc/intel/atom/Kconfig"
osource "D:/Zephyr/zephyr/soc/intel/apollo_lake/Kconfig"
osource "D:/Zephyr/zephyr/soc/intel/alder_lake/Kconfig"
osource "D:/Zephyr/zephyr/soc/infineon/cat3/Kconfig"
osource "D:/Zephyr/zephyr/soc/infineon/cat1c/Kconfig"
osource "D:/Zephyr/zephyr/soc/infineon/cat1b/Kconfig"
osource "D:/Zephyr/zephyr/soc/infineon/cat1a/Kconfig"
osource "D:/Zephyr/zephyr/soc/gd/gd32/Kconfig"
osource "D:/Zephyr/zephyr/soc/gaisler/leon3/Kconfig"
osource "D:/Zephyr/zephyr/soc/gaisler/gr716a/Kconfig"
osource "D:/Zephyr/zephyr/soc/espressif/Kconfig"
osource "D:/Zephyr/zephyr/soc/ene/kb1200/Kconfig"
osource "D:/Zephyr/zephyr/soc/efinix/sapphire/Kconfig"
osource "D:/Zephyr/zephyr/soc/cdns/xtensa_sample_controller/Kconfig"
osource "D:/Zephyr/zephyr/soc/cdns/sample_controller32/Kconfig"
osource "D:/Zephyr/zephyr/soc/cdns/dc233c/Kconfig"
osource "D:/Zephyr/zephyr/soc/brcm/bcmvk/Kconfig"
osource "D:/Zephyr/zephyr/soc/brcm/bcm2712/Kconfig"
osource "D:/Zephyr/zephyr/soc/brcm/bcm2711/Kconfig"
osource "D:/Zephyr/zephyr/soc/bflb/Kconfig"
osource "D:/Zephyr/zephyr/soc/atmel/sam0/Kconfig"
osource "D:/Zephyr/zephyr/soc/atmel/sam/Kconfig"
osource "D:/Zephyr/zephyr/soc/aspeed/Kconfig"
osource "D:/Zephyr/zephyr/soc/arm/Kconfig"
osource "D:/Zephyr/zephyr/soc/arm/beetle/Kconfig"
osource "D:/Zephyr/zephyr/soc/antmicro/myra/Kconfig"
osource "D:/Zephyr/zephyr/soc/andestech/Kconfig"
osource "D:/Zephyr/zephyr/soc/amd/acp_6_0/Kconfig"
osource "D:/Zephyr/zephyr/soc/ambiq/Kconfig"
osource "D:/Zephyr/zephyr/soc/aesc/Kconfig"
osource "D:/Zephyr/zephyr/soc/adi/max32/Kconfig"
```

## blinky/build/Kconfig/soc/Kconfig.soc
```kconfig
# Load SoC Kconfig descriptions.
osource "D:/Zephyr/zephyr/soc/xlnx/zynqmp/Kconfig.soc"
osource "D:/Zephyr/zephyr/soc/xlnx/zynq7000/Kconfig.soc"
osource "D:/Zephyr/zephyr/soc/xlnx/versalnet/Kconfig.soc"
osource "D:/Zephyr/zephyr/soc/xlnx/versal2/Kconfig.soc"
osource "D:/Zephyr/zephyr/soc/xen/Kconfig.soc"
osource "D:/Zephyr/zephyr/soc/wch/ch32v/Kconfig.soc"
osource "D:/Zephyr/zephyr/soc/ti/simplelink/Kconfig.soc"
osource "D:/Zephyr/zephyr/soc/ti/mspm0/Kconfig.soc"
osource "D:/Zephyr/zephyr/soc/ti/lm3s6965/Kconfig.soc"
osource "D:/Zephyr/zephyr/soc/ti/k3/Kconfig.soc"
osource "D:/Zephyr/zephyr/soc/telink/tlsr/Kconfig.soc"
osource "D:/Zephyr/zephyr/soc/starfive/jh71xx/Kconfig.soc"
osource "D:/Zephyr/zephyr/soc/st/stm32/Kconfig.soc"
osource "D:/Zephyr/zephyr/soc/snps/qemu_arc/Kconfig.soc"
osource "D:/Zephyr/zephyr/soc/snps/nsim/arc_v/Kconfig.soc"
osource "D:/Zephyr/zephyr/soc/snps/nsim/arc_classic/Kconfig.soc"
osource "D:/Zephyr/zephyr/soc/snps/hsdk4xd/Kconfig.soc"
osource "D:/Zephyr/zephyr/soc/snps/hsdk/Kconfig.soc"
osource "D:/Zephyr/zephyr/soc/snps/emsk/Kconfig.soc"
osource "D:/Zephyr/zephyr/soc/snps/emsdp/Kconfig.soc"
osource "D:/Zephyr/zephyr/soc/snps/arc_iot/Kconfig.soc"
osource "D:/Zephyr/zephyr/soc/silabs/Kconfig.soc"
osource "D:/Zephyr/zephyr/soc/sifive/sifive_freedom/Kconfig.soc"
osource "D:/Zephyr/zephyr/soc/sensry/Kconfig.soc"
osource "D:/Zephyr/zephyr/soc/rockchip/Kconfig.soc"
osource "D:/Zephyr/zephyr/soc/renode/riscv_virtual/Kconfig.soc"
osource "D:/Zephyr/zephyr/soc/renode/cortex_r8_virtual/Kconfig.soc"
osource "D:/Zephyr/zephyr/soc/renesas/smartbond/Kconfig.soc"
osource "D:/Zephyr/zephyr/soc/renesas/rz/Kconfig.soc"
osource "D:/Zephyr/zephyr/soc/renesas/rx/Kconfig.soc"
osource "D:/Zephyr/zephyr/soc/renesas/rcar/Kconfig.soc"
osource "D:/Zephyr/zephyr/soc/renesas/ra/Kconfig.soc"
osource "D:/Zephyr/zephyr/soc/realtek/ec/Kconfig.soc"
osource "D:/Zephyr/zephyr/soc/raspberrypi/rpi_pico/Kconfig.soc"
osource "D:/Zephyr/zephyr/soc/quicklogic/eos_s3/Kconfig.soc"
osource "D:/Zephyr/zephyr/soc/qemu/virt_riscv/Kconfig.soc"
osource "D:/Zephyr/zephyr/soc/qemu/malta/Kconfig.soc"
osource "D:/Zephyr/zephyr/soc/openisa/rv32m1/Kconfig.soc"
osource "D:/Zephyr/zephyr/soc/openhwgroup/cva6/Kconfig.soc"
osource "D:/Zephyr/zephyr/soc/oct/osd32mp15x/Kconfig.soc"
osource "D:/Zephyr/zephyr/soc/nxp/s32/Kconfig.soc"
osource "D:/Zephyr/zephyr/soc/nxp/rw/Kconfig.soc"
osource "D:/Zephyr/zephyr/soc/nxp/mcx/Kconfig.soc"
osource "D:/Zephyr/zephyr/soc/nxp/lpc/Kconfig.soc"
osource "D:/Zephyr/zephyr/soc/nxp/layerscape/Kconfig.soc"
osource "D:/Zephyr/zephyr/soc/nxp/kinetis/Kconfig.soc"
osource "D:/Zephyr/zephyr/soc/nxp/imxrt/Kconfig.soc"
osource "D:/Zephyr/zephyr/soc/nxp/imx/Kconfig.soc"
osource "D:/Zephyr/zephyr/soc/nuvoton/numicro/Kconfig.soc"
osource "D:/Zephyr/zephyr/soc/nuvoton/numaker/Kconfig.soc"
osource "D:/Zephyr/zephyr/soc/nuvoton/npcx/Kconfig.soc"
osource "D:/Zephyr/zephyr/soc/nuvoton/npcm/Kconfig.soc"
osource "D:/Zephyr/zephyr/soc/nordic/Kconfig.soc"
osource "D:/Zephyr/zephyr/soc/neorv32/Kconfig.soc"
osource "D:/Zephyr/zephyr/soc/native/inf_clock/Kconfig.soc"
osource "D:/Zephyr/zephyr/soc/microchip/sam/Kconfig.soc"
osource "D:/Zephyr/zephyr/soc/microchip/miv/Kconfig.soc"
osource "D:/Zephyr/zephyr/soc/microchip/mec/Kconfig.soc"
osource "D:/Zephyr/zephyr/soc/mediatek/mt8xxx/Kconfig.soc"
osource "D:/Zephyr/zephyr/soc/lowrisc/opentitan/Kconfig.soc"
osource "D:/Zephyr/zephyr/soc/litex/litex_vexriscv/Kconfig.soc"
osource "D:/Zephyr/zephyr/soc/ite/ec/Kconfig.soc"
osource "D:/Zephyr/zephyr/soc/intel/raptor_lake/Kconfig.soc"
osource "D:/Zephyr/zephyr/soc/intel/lakemont/Kconfig.soc"
osource "D:/Zephyr/zephyr/soc/intel/intel_socfpga_std/Kconfig.soc"
osource "D:/Zephyr/zephyr/soc/intel/intel_socfpga/Kconfig.soc"
osource "D:/Zephyr/zephyr/soc/intel/intel_niosv/Kconfig.soc"
osource "D:/Zephyr/zephyr/soc/intel/intel_ish/Kconfig.soc"
osource "D:/Zephyr/zephyr/soc/intel/intel_adsp/Kconfig.soc"
osource "D:/Zephyr/zephyr/soc/intel/elkhart_lake/Kconfig.soc"
osource "D:/Zephyr/zephyr/soc/intel/atom/Kconfig.soc"
osource "D:/Zephyr/zephyr/soc/intel/apollo_lake/Kconfig.soc"
osource "D:/Zephyr/zephyr/soc/intel/alder_lake/Kconfig.soc"
osource "D:/Zephyr/zephyr/soc/infineon/cat3/Kconfig.soc"
osource "D:/Zephyr/zephyr/soc/infineon/cat1c/Kconfig.soc"
osource "D:/Zephyr/zephyr/soc/infineon/cat1b/Kconfig.soc"
osource "D:/Zephyr/zephyr/soc/infineon/cat1a/Kconfig.soc"
osource "D:/Zephyr/zephyr/soc/gd/gd32/Kconfig.soc"
osource "D:/Zephyr/zephyr/soc/gaisler/leon3/Kconfig.soc"
osource "D:/Zephyr/zephyr/soc/gaisler/gr716a/Kconfig.soc"
osource "D:/Zephyr/zephyr/soc/espressif/Kconfig.soc"
osource "D:/Zephyr/zephyr/soc/ene/kb1200/Kconfig.soc"
osource "D:/Zephyr/zephyr/soc/efinix/sapphire/Kconfig.soc"
osource "D:/Zephyr/zephyr/soc/cdns/xtensa_sample_controller/Kconfig.soc"
osource "D:/Zephyr/zephyr/soc/cdns/sample_controller32/Kconfig.soc"
osource "D:/Zephyr/zephyr/soc/cdns/dc233c/Kconfig.soc"
osource "D:/Zephyr/zephyr/soc/brcm/bcmvk/Kconfig.soc"
osource "D:/Zephyr/zephyr/soc/brcm/bcm2712/Kconfig.soc"
osource "D:/Zephyr/zephyr/soc/brcm/bcm2711/Kconfig.soc"
osource "D:/Zephyr/zephyr/soc/bflb/Kconfig.soc"
osource "D:/Zephyr/zephyr/soc/atmel/sam0/Kconfig.soc"
osource "D:/Zephyr/zephyr/soc/atmel/sam/Kconfig.soc"
osource "D:/Zephyr/zephyr/soc/aspeed/Kconfig.soc"
osource "D:/Zephyr/zephyr/soc/arm/Kconfig.soc"
osource "D:/Zephyr/zephyr/soc/arm/beetle/Kconfig.soc"
osource "D:/Zephyr/zephyr/soc/antmicro/myra/Kconfig.soc"
osource "D:/Zephyr/zephyr/soc/andestech/Kconfig.soc"
osource "D:/Zephyr/zephyr/soc/amd/acp_6_0/Kconfig.soc"
osource "D:/Zephyr/zephyr/soc/ambiq/Kconfig.soc"
osource "D:/Zephyr/zephyr/soc/aesc/Kconfig.soc"
osource "D:/Zephyr/zephyr/soc/adi/max32/Kconfig.soc"
```
